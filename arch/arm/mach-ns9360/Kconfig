## arch/arm/mach-ns9360/Kconfig
```kconfig
# SPDX-License-Identifier: GPL-2.0+

if ARCH_NS9360

config SYS_SOC
	default "ns9360"

choice
	prompt "Digi NS9360 board select"

config TARGET_HPE_IPDU
	bool "HPE Intelligent Modular PDU (AF531A)"
	help
	  HPE Intelligent Modular PDU with NS9360B SoC,
	  32 MB SDRAM, 16 MB NOR flash (2x 8 MB), Ethernet.

endchoice

source "board/hpe/ipdu/Kconfig"

endif
```

## board/hpe/ipdu/Kconfig
```kconfig
if TARGET_HPE_IPDU

config SYS_BOARD
	default "ipdu"

config SYS_VENDOR
	default "hpe"

config SYS_SOC
	default "ns9360"

config SYS_CONFIG_NAME
	default "hpe_ipdu"

config TEXT_BASE
	default 0x40000000

config SYS_MONITOR_BASE
	default TEXT_BASE

endif
```

## configs/hpe_ipdu_defconfig
```kconfig
CONFIG_ARM=y
CONFIG_ARCH_NS9360=y
CONFIG_TARGET_HPE_IPDU=y
CONFIG_DEFAULT_DEVICE_TREE="ns9360-hpe-ipdu"
CONFIG_SYS_CLK_FREQ=176947200
CONFIG_BAUDRATE=115200
CONFIG_SYS_LOAD_ADDR=0x00200000
CONFIG_SYS_MALLOC_LEN=0x40000
# CONFIG_AUTOBOOT is not set

# Serial
CONFIG_NS9360_SERIAL=y

# GPIO
CONFIG_DM_GPIO=y
CONFIG_NS9360_GPIO=y
CONFIG_CMD_GPIO=y

# Clock
CONFIG_CLK=y
CONFIG_CLK_NS9360=y

# Ethernet
CONFIG_NETDEVICES=y
CONFIG_NS9360_ETH=y
CONFIG_CMD_NET=y
CONFIG_CMD_PING=y
CONFIG_CMD_DHCP=y
CONFIG_CMD_MII=y

# Flash
CONFIG_SYS_FLASH_CFI=y
CONFIG_FLASH_CFI_DRIVER=y
CONFIG_SYS_MAX_FLASH_BANKS=2
CONFIG_ENV_IS_IN_FLASH=y
CONFIG_ENV_ADDR=0x507F0000
CONFIG_ENV_SECT_SIZE=0x10000
CONFIG_ENV_SIZE=0x10000

# Memory commands
CONFIG_CMD_MEMORY=y

# Standard commands
CONFIG_CMD_FLASH=y
CONFIG_CMD_ENV=y
CONFIG_CMD_RUN=y
CONFIG_CMD_BOOTM=y
CONFIG_CMD_GO=y
```
